#include "temp.h"
#include "adc.h"
#include "global.h"


/*
@10K ntc
*/
static const int32_t tempTable3950_10K[][2] = {

{-40 ,3409281},		
{-39,	3188772},	
{-38,	2983978},	
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{105,	5821},

};


/*
@功能：阻值温度查表
@参数：电阻值
@说明：采用折半查找
*/
static int temp_search(uint32_t res)
{
	uint16_t last, beg = 0, mid = 0, limit;
	
	last = sizeof(tempTable3950_10K)/8;
	res *= 10;//电阻放大10倍
	
	/*
	也可以人为限制有效温度范围（设置beg与last）
	*/
	limit = last;//做限制使用
   
	while(beg <= last)
	{  
		mid = (beg + last) / 2;
		
		if(mid >= limit)
			return 128;//255表示-1度，用128来表示无效
	
		if (res == tempTable3950_10K[mid][1] || (tempTable3950_10K[mid][1] > res && tempTable3950_10K[mid+1][1] < res)) 
		{  
			return tempTable3950_10K[mid][0];
		}
		else
		if (tempTable3950_10K[mid][1] > res)
		{  
			beg = mid + 1;
		}
		else 
		if (tempTable3950_10K[mid][1] < res)
		{  
			last = mid - 1;
		}
	}  
  
	return 128;  //表示错误，没有这个值
	
}


/*
@功能：获取内部温度
@返回：温度值，有符号数
*/
int get_internal_temp(void)
{
//	printf("Current Temperature = %2.1f\n\n", (25+(((float)get_internal_senser_adc()/4095*3300)-675)/(-1.83)));
	return (25+(((float)get_internal_senser_adc()/4095*3300)-675)/(-1.83));
}


/*
@功能：获取外部温度
@参数：val，温度值；state，温度头状态
*/
void get_external_temp(int *val, uint8_t *state)
{
	uint32_t res_val = 0;//电阻值
	uint16_t adc1 = 0, adc2 = 0, adc3 = 0;
	uint16_t average_adc = 0;
	
	adc1 = get_external_senser_adc();//查询adc检测值
	adc2 = get_external_senser_adc();//查询adc检测值
	adc3 = get_external_senser_adc();//查询adc检测值
	
	average_adc = (adc1 + adc2 + adc3)/3;
	
	//检测温度
	if(average_adc < 10)//adc值
	{
		*state = 0;//没插温度头
	}
	else
	{
		res_val = 10000*4095/average_adc-10000;//阻值
		*val = temp_search(res_val);//根据阻值查温度
		*state = 1;
	}
	
}
